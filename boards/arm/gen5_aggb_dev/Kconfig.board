## dts/bindings/pio/pio-controller.yaml
```yaml
# Copyright (c) 2021, Yonatan Schachter
# SPDX-License-Identifier: Apache-2.0

description: Raspberry Pi Pico PIO

compatible: "pio-controller"

include: base.yaml
```

## dts/bindings/pio/rasoberrypi,pico-pio.yaml
```yaml
# Copyright (c) 2021, Yonatan Schachter
# SPDX-License-Identifier: Apache-2.0

description: Raspberry Pi Pico PIO

compatible: "raspberrypi,pico-pio"

include: [pio-controller.yaml, reset-device.yaml, base.yaml]

properties:
    gpios:
      type: phandle-array
      required: true
      description: hoge
```

## dts/bindings/plc/maxim,max79356-plc.yaml
```yaml
include: base.yaml

description: Maxim MAX79356 PLC

compatible: "maxim,max79356-plc"

properties:
  ext-mac-address:
    type: uint8-array
    required: true
    description: Sets extended mac eddress of the device
  short-address:
    type: int
    required: true
    description: Sets the short address of the device
  pan-id:
    type: uint8-array
    required: true
    description: Sets the short address of the device
  multicast-group:
    type: int
    required: true
    description: Multicast group that the device will automatically join
  broadcast-group:
    type: int
    required: true
    description: Broadcast group that the device will automatically join
  hw-reset-gpios:
    type: phandle-array
    required: true
    description: GPIO port and pin for hardware reset
  hw-prog-gpios:
    type: phandle-array
    required: true
    description: GPIO port and pin for programming the plc chip
```

## dts/bindings/power-domain/power-domain-gpio.yaml
```yaml
# Copyright (c) 2022, CSIRO
# SPDX-License-Identifier: Apache-2.0

description: Simple GPIO controlled power domain

compatible: "power-domain-gpio"

include: power-domain.yaml

properties:
  enable-gpios:
    type: phandle-array
    required: true
    description: |
      GPIO to use to enable/disable the regulator.

      Unlike the gpio property in the Linux bindings this array must
      provide the GPIO polarity and open-drain status in the phandle
      selector.  The Linux enable-active-high and gpio-open-drain
      properties are not valid for Zephyr devicetree files.

  enable-pin-high-drive:
    type: boolean
    description:
      Drive the enable pin with the highest possible drive strength.
      This is useful when the enable pin is used as the power source
      itself.

  startup-delay-us:
    type: int
    required: false
    default: 0
    description: Startup time, in microseconds

  off-on-delay-us:
    type: int
    required: false
    default: 0
    description: Off delay time, in microseconds

  init-priority:
    type: int
    default: 75
    description: |
      Device initialisation priority. Powre domains that depend on other
      power domains must be initiliased AFTER the dependant domain.
```

## dts/bindings/serial/raspberrypi,pico-uart-pio.yaml
```yaml
description: Raspberry Pi Pico PIO UART

compatible: "raspberrypi,pico-uart-pio"

include: ["uart-controller.yaml", "pinctrl-device.yaml", "reset-device.yaml"]
```

## soc/arm/nxp_imx/rt117x/Kconfig.defconfig.series
```kconfig
# i.MX RT117x series

# Copyright (c) 2020, NXP
# SPDX-License-Identifier: Apache-2.0

if SOC_SERIES_IMX_RT117X

config SOC_SERIES
	default "rt117x"

config ROM_START_OFFSET
	default 0x2000 if BOOT_FLEXSPI_NOR || BOOT_SEMC_NOR

config CAN_MCUX_FLEXCAN
	default y if HAS_MCUX_FLEXCAN
	depends on CAN

config CLOCK_CONTROL_MCUX_CCM_RT117X
	default y if HAS_MCUX_CCM
	depends on CLOCK_CONTROL

config DISK_ACCESS_USDHC
	default y if (HAS_MCUX_USDHC1 || HAS_MCUX_USDHC2)
	depends on DISK_ACCESS_SDHC

config DISPLAY_MCUX_ELCDIF
	default y if HAS_MCUX_ELCDIF
	depends on DISPLAY

config GPIO_MCUX_IGPIO
	default y if HAS_MCUX_IGPIO
	depends on GPIO

config I2C_MCUX_LPI2C
	default y if HAS_MCUX_LPI2C
	depends on I2C

config UART_MCUX_LPUART
	default y if HAS_MCUX_LPUART
	depends on SERIAL

if COUNTER

config COUNTER_MCUX_GPT
	default y if HAS_MCUX_GPT

endif # COUNTER

config SPI_MCUX_LPSPI
	default y if HAS_MCUX_LPSPI
	depends on SPI

config WDT_MCUX_IMX_WDOG
	default y
	depends on WATCHDOG

if CODE_SEMC

config FLASH_SIZE
	default $(dt_node_reg_size_int,/memory@80000000,0,K)

config FLASH_BASE_ADDRESS
	default $(dt_node_reg_addr_hex,/memory@80000000)

endif # CODE_SEMC

if CODE_ITCM

config FLASH_SIZE
	default $(dt_node_reg_size_int,/soc/flexram@40028000/itcm@0,0,K)

config FLASH_BASE_ADDRESS
	default $(dt_node_reg_addr_hex,/soc/flexram@40028000/itcm@0)

endif # CODE_ITCM

if CODE_SRAM0

config FLASH_SIZE
	default $(dt_node_reg_size_int,/soc/memory@1ffe0000,0,K)

config FLASH_BASE_ADDRESS
	default $(dt_node_reg_addr_hex,/soc/memory@1ffe0000)

endif # CODE_SRAM0


if CODE_FLEXSPI

config FLASH_SIZE
	default $(dt_node_reg_size_int,/soc/spi@400cc000,1,K)

config FLASH_BASE_ADDRESS
	default $(dt_node_reg_addr_hex,/soc/spi@400cc000,1)

endif # CODE_FLEXSPI

if CODE_FLEXSPI2

config FLASH_SIZE
	default $(dt_node_reg_size_int,/soc/spi@4000d000,1,K)

config FLASH_BASE_ADDRESS
	default $(dt_node_reg_addr_hex,/soc/spi@4000d000,1)

endif # CODE_FLEXSPI2

config DMA_MCUX_EDMA
	default y if HAS_MCUX_EDMA
	depends on DMA

source "soc/arm/nxp_imx/rt117x/Kconfig.defconfig.mimxrt*"

endif #  SOC_SERIES_IMX_RT117X
```

## soc/arm/nxp_imx/rt117x/Kconfig.series
```kconfig
# iMX RT117x series

# Copyright (c) 2020, NXP
# SPDX-License-Identifier: Apache-2.0

config SOC_SERIES_IMX_RT117X
	bool "i.MX RT117X Series"
	select ARM
	select SOC_FAMILY_IMX
	select CLOCK_CONTROL
	help
	  Enable support for i.MX RT117X MCU series
```
