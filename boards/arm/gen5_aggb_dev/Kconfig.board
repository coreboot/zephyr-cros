## boards/arm/gen5_aggb_dev/Kconfig.board
```kconfig
# SPDX-License-Identifier: Apache-2.0
#
# Copyright (c) 2022 Schlumberger

config BOARD_GEN5_AGGB_DEV
	bool "Infineon XMC4700 Gen5 Aggregator Dev"
	depends on SOC_SERIES_XMC_4XXX
	select SOC_PART_NUMBER_F144X2048
```

## boards/arm/gen5_aggb_dev/Kconfig.defconfig
```kconfig
# SPDX-License-Identifier: Apache-2.0
#
# Copyright (c) 2022 Schlumberger

if BOARD_GEN5_AGGB_DEV

config BOARD
	default "gen5_aggb_dev"

config ETH_XMC4XXX_MAC_EEPROM_ADDRESS
	default 0xfa
	depends on ETH_XMC4XXX

endif
```

## boards/arm/gen5_aggb_downhole/Kconfig.board
```kconfig
# SPDX-License-Identifier: Apache-2.0
#
# Copyright (c) 2022 Schlumberger

config BOARD_GEN5_AGGB_DOWNHOLE
	bool "Infineon XMC4700 Gen5 Aggregator Downhole"
	depends on SOC_SERIES_XMC_4XXX
	select SOC_PART_NUMBER_F144X2048
```

## boards/arm/gen5_aggb_downhole/gen5_aggb_downhole_defconfig
```kconfig
# SPDX-License-Identifier: Apache-2.0
#
# Copyright (c) 2023 Schlumberger

CONFIG_BOARD_GEN5_AGGB_DOWNHOLE=y
CONFIG_SOC_SERIES_XMC_4XXX=y
CONFIG_SOC_XMC4700=y
CONFIG_CORTEX_M_SYSTICK=y

# enable uart driver
CONFIG_SERIAL=y

# enable console
CONFIG_CONSOLE=n
CONFIG_UART_CONSOLE=n

CONFIG_GPIO=y

CONFIG_USE_DT_CODE_PARTITION=y

CONFIG_SPI_NOR_FLASH_LAYOUT_PAGE_SIZE=4096
CONFIG_SPI_XMC4XXX_DMA=y
```

## boards/arm/gen5_combo/Kconfig.board
```kconfig
# SPDX-License-Identifier: Apache-2.0
#
# Copyright (c) 2022 Schlumberger

config BOARD_GEN5_COMBO
	bool "Infineon XMC4700 Gen5 Combo"
	depends on SOC_SERIES_XMC_4XXX
	select SOC_PART_NUMBER_F144X2048
```

## boards/arm/gen5_modem/Kconfig.defconfig
```kconfig
# SPDX-License-Identifier: Apache-2.0
#
# Copyright (c) 2022 Schlumberger

if BOARD_GEN5_MODEM

config BOARD
	default "gen5_modem"

config ETH_XMC4XXX_MAC_EEPROM_ADDRESS
	default 0xfa
	depends on ETH_XMC4XXX

endif
```

## boards/arm/gen5_modem/gen5_modem_defconfig
```kconfig
# SPDX-License-Identifier: Apache-2.0
#
# Copyright (c) 2020 Schlumberger
# Author: Andriy Gelman <andriy.gelman@gmail.com>

CONFIG_BOARD_GEN5_MODEM=y
CONFIG_SOC_SERIES_XMC_4XXX=y
CONFIG_SOC_XMC4700=y
CONFIG_CORTEX_M_SYSTICK=y

# enable uart driver
CONFIG_SERIAL=y

# enable console
CONFIG_CONSOLE=n
CONFIG_UART_CONSOLE=n

CONFIG_GPIO=y

CONFIG_USE_DT_CODE_PARTITION=y
```

## cmake/toolchain/arcmwdt/Kconfig
```kconfig
# Copyright (c) 2022 CSIRO
# SPDX-License-Identifier: Apache-2.0

config TOOLCHAIN_SUPPORTS_GNU_BUILD_ID
	bool
	default n
```

## drivers/clock_control/Kconfig.mcux_ccm_rt117x
```kconfig
# MCUXpresso SDK CCM

# Copyright (c) 2021, NXP
# SPDX-License-Identifier: Apache-2.0

config CLOCK_CONTROL_MCUX_CCM_RT117X
	bool "MCUX CCM RT117X driver"
	depends on HAS_MCUX_CCM
	help
	  Enable support for mcux ccm rt117x driver.
```

## drivers/clock_control/Kconfig.xmc4xxx
```kconfig
# Copyright (C) 2023 SLB
# SPDX-License-Identifier: Apache-2.0

config CLOCK_CONTROL_XMC4XXX
	bool "Infineon XMC4xxx clock control driver"
	default y
	depends on DT_HAS_INFINEON_XMC4XXX_CSU_ENABLED
	help
	  This option enables the clock select unit (CSU) for Infineon XMC4xxx.
```

## drivers/flash/Kconfig.mt29fx
```kconfig
# Copyright (c) 2023 Schlumberger
# SPDX-License-Identifier: Apache-2.0

config MICRON_MT29FX_MEMC_NAND
	bool "Micron mt29fx Nand flash driver"
	default y
	depends on DT_HAS_MICRON_MT29FX_MEMC_NAND_ENABLED
	select FLASH_HAS_PAGE_LAYOUT
	select FLASH_HAS_DRIVER_ENABLED
	select GPIO
	select MEMC
	select FLASH_HAS_EX_OP
	select FLASH_EX_OP_ENABLED
	select FLASH_64_BIT_API
	help
          Enables Micron mt29fx Nand flash driver.

config MICRON_MT29FX_MEMC_NAND_USE_EXTERNAL_ECC
	bool "Use external ECC"
	select FLASH_ECC_BCH
	help
	  Use external ECC if internal ECC is not supported.

config MICRON_MT29FX_MEMC_NAND_USE_DMA
	bool "Use DMA for data transfers"
	default y
	depends on MICRON_MT29FX_MEMC_NAND
	help
	  Use DMA for reading/writing data to the chip.


if MICRON_MT29FX_MEMC_NAND_USE_DMA

config MICRON_MT29FX_MEMC_NAND_ASYNC_DMA
	bool "Use Asynchronouse DMA for transaction"
	default y
	depends on MICRON_MT29FX_MEMC_NAND
	help
	  Wait for a callback from DMA handler to complete transaction.

config MICRON_MT29FX_MEMC_NAND_ASYNC_DMA_TIMEOUT_MS
	int "Timeout for DMA transaction to complete"
	default 200
	help
	  Timeout for DMA transaction to complete.

endif
```

## drivers/pio/Kconfig
```kconfig
menu "Programmable IO"

config PIO
	bool "pio"
	default y

source "drivers/pio/Kconfig.rpi_pico"

endmenu
```

## drivers/serial/Kconfig.rpi_pico
```kconfig
# Copyright (c) 2021 Yonatan Schachter
# SPDX-License-Identifier: Apache-2.0

# Workaround for not being able to have commas in macro arguments
DT_COMPAT_RPI_PICO_UART := raspberrypi,pico-uart
DT_COMPAT_RPI_PICO_UART_PIO := raspberrypi,pico-uart-pio

config UART_RPI_PICO
	bool "Raspberry Pi UART driver"
	default $(dt_compat_enabled,$(DT_COMPAT_RPI_PICO_UART))
	select SERIAL_HAS_DRIVER
	select PICOSDK_USE_UART
	select SERIAL_SUPPORT_INTERRUPT
	depends on RESET

config UART_RPI_PICO_PIO
	bool "Raspberry Pi PIO UART driver"
	default $(dt_compat_enabled,$(DT_COMPAT_RPI_PICO_UART_PIO))
	select SERIAL_HAS_DRIVER
	select PICOSDK_USE_PIO
	select PICOSDK_USE_CLAIM
	depends on RESET
```

## dts/bindings/clock/infineon,xmc4xxx-csu.yaml
```yaml
# Copyright (c) 2023 SLB
# SPDX-License-Identifier: Apache-2.0

description: |
  Infineon XMC4xxx Clock Select Unit (CSU) is part of the System Control
  Unit (SCU).

  To specify the clocks in a peripheral, the standard clocks property needs
  to be used, e.g.:

    usic0ch0: usic@xxx {
        ...
        /* cell encodes the clock id */
        clocks = <&cctl XMC4XXX_CLOCK_USIC>;
        ...
    }

compatible: "infineon,xmc4xxx-csu"

include: [base.yaml, clock-controller.yaml, pinctrl-device.yaml]

properties:
  "#clock-cells":
    const: 1

  fext-clk-source:
    type: string
    description:
      Input clock source for the external clock.
    enum:
      - "f_sys"
      - "f_pll"
      - "f_usbpll"

  fext-clk-divider:
    type: int
    description:
      Clock divider if pll or usbpll are used as the input clock source.
      The value has no effect if f_sys is selected as the clock.

clock-cells:
  - id
```

## dts/bindings/memory-controllers/infineon,xmc4xxx-ebu.yaml
```yaml
# Copyright (c) 2022, Schlumberger
# SPDX-License-Identifier: Apache-2.0

description: |
  Infineon XMC4XXX external bus unit (EBU).

  The EBU is used to connect to various types of memory devices such as
  Asynchronous SRAM, SDRAM and NAND flash. Up to four memory regions are supported
  and each can have its own timing/device configurations.

  The EBU supports up to four devices, where each one is enabled via chip select line.
  Each device has a separate executable address space.

  Region 0: 0x60000000 - 0x63ffffff
  Region 1: 0x64000000 - 0x67ffffff
  Region 2: 0x68000000 - 0x6bffffff
  Region 3: 0x6c000000 - 0x6fffffff

  An alternative address space which does not allow executing instructions is
  available at

  Region 0: 0xa0000000 - 0xa3ffffff
  Region 1: 0xa4000000 - 0xa7ffffff
  Region 2: 0xa8000000 - 0xabffffff
  Region 3: 0xac000000 - 0xafffffff

  The alternative or standard address space can be enabled using options below.

  The EBU has a set of global configuration (i.e. clock, pinctrl, ...) and a per
  region read/write timing configurations. The dts example below sets up region 0
  to use SDRAM (IS45S16400F) with the Infineon XMC4800 automation board.

  &ebu {
      pinctrl-0 = <&ebu_p0_2_ad0 &ebu_p0_3_ad1 ... >;
      pinctrl-names = "default";
      clk-config = <XMC4XXX_EBU_SET_CLC(0, 1, 0)>;
      modes-config = <XMC4XXX_EBU_SET_MODCON(0, 0, 0, 3, 0, 0)>;
      gpio-control-config = <XMC4XXX_EBU_SET_USERCON(0x1ff, 0)>;
      sdram-control = <XMC4XXX_EBU_SET_SDRMCON(0, 0, 0, 0, 2, 1, 5, 1, 1, 1, 0, 0, 0)>;
      sdram-operation-mode = <XMC4XXX_EBU_SDRMOD(0, 0, 1, 0, 3, 0)>;
      sdram-refresh-control = <XMC4XXX_EBU_SDRMREF(7, 1, 255, 0, 1, 1, 1, 2)>;
      ebu_sdram@0 {
              reg = <0>;
              device-type = "SDRAM";
              address-bus-width = "16-bit";
              region-enable;
              alternate-region-enable;
              bus-read-config = <XMC4XXX_EBU_SET_BUSRCON(3, 0, 0, 1, 0, 0, 0, 0, 0, 0, 1, 0, 0)>;
              bus-read-timing = <XMC4XXX_EBU_SET_BUSRAP(15, 7, 4, 0, 0, 0, 15, 15, 15)>;
              bus-write-config = <XMC4XXX_EBU_SET_BUSWCON(3, 0, 0, 0, 0, 0, 1, 0, 0, 0)>;
              bus-write-timing = <XMC4XXX_EBU_SET_BUSWAP(15, 7, 4, 0, 0, 0, 15, 15, 15)>;
      };
      status = "okay";
  };

  The memory region is accessible by defining the node

  sdram1: sdram@60000000 {
      compatible = "zephyr,memory-region", "mmio-sram";
      device_type = "memory";
      reg = <0x60000000 DT_SIZE_M(8)>;
      zephyr,memory-region = "SDRAM1";
  };

  The following properties define the EBU registers outlined in the XMC4XXX reference
  manual. A large number of configurations are exposed and it is recommended
  to carefully review the XMC4XXX manual to choose the proper settings for your
  target device.

  Each of the properties has a macro to simplify setting the values. The bitflags
  use the same names as defined in the reference manual.

compatible: "infineon,xmc4xxx-ebu"

include: [base.yaml, pinctrl-device.yaml]

properties:
  reg:
    required: true

  "#address-cells":
    required: true
    const: 1

  "#size-cells":
    required: true
    const: 0

  clock-divider:
    type: int
    required: true
    description: |
      The external bus clock is derived from the CPU clock divided by this value.

  modes-config:
    type: int
    required: true
    description: |
      Sets Modes Configuration (MODCON) register. This mainly sets the arbitration parameters.
      Also it is used to configure whether address latch enable (ALE) is active high or low and whether SDRAM
      pins CKE, SDCLKO, CAS, and RAS are in tri-state when the EBU does not own the external bus.
      Use macro XMC4XXX_EBU_SET_MODCON(sdtri, extlock, arbsync, arbmode, timeoutc, ale).

  gpio-control-config:
    type: int
    required: true
    description: |
      Configures USERCON register. This register allows the user to free unused gpio pins.
      Use macro XMC4XXX_EBU_SET_USERCON(addio, advio).

  sdram-control:
    type: int
    required: false
    description: |
      Configures SDRMCON register.
      Use macro XMC4XXX_EBU_SET_SDRMCON(sdcmsel, pwr_mode, clkdis, crce, bankm,
      rowm, crc, crcd, awidth, crp, crsc, crfsh, cras).

  sdram-operation-mode:
    type: int
    required: false
    description: |
      Configures SDRMOD register.
      Use macro XMC4XXX_EBU_SDRMOD(xba, xopm, coldstart, opmode, caslat, burstl).

  sdram-refresh-control:
    type: int
    required: false
    description: |
      Configures SDRMREF register.
      Use macro XMC4XXX_EBU_SDRMREF(res_dly, arfsh, selfrex_dly, erfshc, autoselfr,
      selfrex, refreshr, refreshc).

child-binding:
  description: |
    Child device nodes are representing devices connected to the EBU bus.

  properties:
    reg:
      type: int
      required: true
      description: Selects the region to configure. All the following properties apply to this region.

    device-type:
      type: string
      required: true
      description: Device type.
      enum:
        - "Muxed Asynchronous Type"
        - "Muxed Burst Type"
        - "NAND Flash"
        - "Muxed Cellular RAM"
        - "Demuxed Asynchronous Type"
        - "Demuxed Burst Type"
        - "Demuxed Page Mode"
        - "Demuxed Cellular RAM"
        - "SDRAM"

    address-bus-width:
      type: string
      required: true
      description: Address bus width configuration.
      enum:
        - "16-bit"
        - "Twin-16-bit"
        - "32-bit"

    address-valid-cycles:
      type: array
      required: true
      description: |
        Address valid duration in clock cycles. The Address will be
        output on the parallel bus during this phase. The first entry
        is for read phase. The second entry is for the write phase.
        Valid range is [0, 15].

    address-hold-cycles:
      type: array
      required: true
      description: |
        Duration of the address hold phase in clock cycles.
        The address valid signal is unset, but the parallel bus still has the
        address. The first entry is for read phase. The second entry
        is for the write phase.
        Valid range is [0,15].

    command-delay-cycles:
      type: array
      required: true
      description: |
        Delay before the read or write signal is output on RD or WR, respectively.
        The first entry is for read phase. The second entry is for the write phase.
        Valid range is [0,15].

    command-cycles:
      type: array
      required: true
      description: |
        Duration of the command phase in clock cycles. When reading, the data is
        clocked in from the external device on the rising edge of the read signal.
        When writing, the data is output on the parallel bus at the start of this
        phase. The first entry is for read phase. The second entry is for the
        write phase.
        Valid range is [1, 32].

    data-hold-cycles:
      type: array
      required: true
      description: |
        Duration of the command hold cycle after the write signal is unset.
        Data is output on the parallel bus during this phase. The first entry is
        for read phase (should be zero). The second entry is for the write phase.
        Valid range is [0,15].

    recovery-cycles:
      type: array
      required: true
      description: |
        Number of clock cycles before the start of the next transaction.
        The first entry is for read phase. The second entry is for the
        write phase.
        Valid range is [0,7].

    write-protect-enable:
      type: boolean
      description: Enables write protection for the address space.

    read-nwait-enable:
      type: boolean
      description: Use nwait signal from peripheral to automatically insert wait states while reading.

    write-nwait-enable:
      type: boolean
      description: Use nwait signal from peripheral to automatically insert wait states while reading.
```

## dts/bindings/mfd/infineon,xmc4xxx-scu.yaml
```yaml
# Copyright (c) 2023 SLB
# SPDX-License-Identifier: Apache-2.0

description: |
  Infineon XMC4xxx System Control Unit (SCU) is a multi-function peripheral
  which handles power control, hibernate control, reset control and clock control.

compatible: "infineon,xmc4xxx-scu"

include: base.yaml

properties:
  reg:
    required: true
```

## dts/bindings/mtd/micron,mt29fx-nand-flash.yaml
```yaml
# Copyright (c) 2023, Schlumberger
# SPDX-License-Identifier: Apache-2.0

description: Micron memory mapped NAND flash device

compatible: "micron,mt29fx-memc-nand"

include: soc-nv-flash.yaml

properties:
  reg:
    required: true

  write-page-size:
    type: int
    required: true

  partial-write-page-size:
    type: int
    required: true

  pages-per-block:
    type: int
    required: true
    description: Number of pages per block. All pages in a block are erased together.

  ecc-chunk-size-bytes:
    type: int

  oob-size-bytes:
    type: int

  num-blocks:
    type: int
    required: true
    description: Number of blocks in the device. Each block is an erasable sector.

  ready-busy-gpios:
    type: phandle-array
    description: External read-busy line

  write-protect-gpios:
    type: phandle-array
    description: External write protect line

  ale-address-mask:
    type: int
    required: true
    description: Address mask to use during an Address stage

  cle-address-mask:
    type: int
    required: true
    description: Address mask to use during a Command stage

  memc-handle:
    type: phandle
    required: true
    description: |
      Specifies a reference to a memc handle

  memc-index:
    type: int
    required: true
    description: |
      Memc index
```
