/*
 * Copyright (c) 2021 Synopsys.
 *
 * SPDX-License-Identifier: Apache-2.0
 */

&i2c1 {
	status = "okay";
	clock-frequency = <I2C_BITRATE_STANDARD>;
		adt7420@4b {
			compatible = "adi,adt7420";
			reg = <0x4b>;
			label = "ADT7420";
		};
};