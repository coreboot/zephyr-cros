## soc/arm/nxp_imx/rt117x/Kconfig.soc
```kconfig
# i.MX RT117x series

# Copyright (c) 2020, NXP
# SPDX-License-Identifier: Apache-2.0

choice
	prompt "i.MX RT117x Selection"
	depends on SOC_SERIES_IMX_RT117X

config SOC_MIMXRT1176_CM7
	bool "SOC_MIMXRT1176_CM7"
	select CPU_CORTEX_M7
	select CPU_CORTEX_M_HAS_DWT
	select HAS_MCUX
	select HAS_MCUX_CACHE
	select HAS_MCUX_CCM
	select HAS_MCUX_IGPIO
	select HAS_MCUX_LPI2C
	select HAS_MCUX_LPSPI
	select HAS_MCUX_LPUART
	select CPU_HAS_ARM_MPU
	select HAS_MCUX_EDMA
	select CPU_HAS_FPU_DOUBLE_PRECISION

config SOC_MIMXRT1176_CM4
	bool "SOC_MIMXRT1176_CM4"
	select CPU_CORTEX_M4
	select HAS_MCUX
	select HAS_MCUX_CACHE
	select HAS_MCUX_CCM
	select HAS_MCUX_IGPIO
	select HAS_MCUX_LPI2C
	select HAS_MCUX_LPSPI
	select HAS_MCUX_LPUART
	select HAS_MCUX_GPT
	select CPU_HAS_ARM_MPU
	select HAS_MCUX_EDMA
	select UPDATE_CM4_CLOCK
endchoice

if SOC_SERIES_IMX_RT117X

config SOC_PART_NUMBER_MIMXRT1176AVM8A
	bool
config SOC_PART_NUMBER_MIMXRT1176CVM8A
	bool
config SOC_PART_NUMBER_MIMXRT1176DVMAA
	bool
config SOC_PART_NUMBER_MIMXRT1175AVM8A
	bool
config SOC_PART_NUMBER_MIMXRT1175CVM8A
	bool
config SOC_PART_NUMBER_MIMXRT1175DVMAA
	bool
config SOC_PART_NUMBER_MIMXRT1173CVM8A
	bool
config SOC_PART_NUMBER_MIMXRT1172AVM8A
	bool
config SOC_PART_NUMBER_MIMXRT1172CVM8A
	bool
config SOC_PART_NUMBER_MIMXRT1172DVMAA
	bool
config SOC_PART_NUMBER_MIMXRT1171AVM8A
	bool
config SOC_PART_NUMBER_MIMXRT1171CVM8A
	bool
config SOC_PART_NUMBER_MIMXRT1171DVMAA
	bool

config SOC_PART_NUMBER_IMX_RT117X
	string
	default "MIMXRT1176AVM8A" if SOC_PART_NUMBER_MIMXRT1176AVM8A
	default "MIMXRT1176CVM8A" if SOC_PART_NUMBER_MIMXRT1176CVM8A
	default "MIMXRT1176DVMAA" if SOC_PART_NUMBER_MIMXRT1176DVMAA
	default "MIMXRT1175AVM8A" if SOC_PART_NUMBER_MIMXRT1175AVM8A
	default "MIMXRT1175CVM8A" if SOC_PART_NUMBER_MIMXRT1175CVM8A
	default "MIMXRT1175DVMAA" if SOC_PART_NUMBER_MIMXRT1175DVMAA
	default "MIMXRT1173CVM8A" if SOC_PART_NUMBER_MIMXRT1173CVM8A
	default "MIMXRT1172AVM8A" if SOC_PART_NUMBER_MIMXRT1172AVM8A
	default "MIMXRT1172CVM8A" if SOC_PART_NUMBER_MIMXRT1172CVM8A
	default "MIMXRT1172DVMAA" if SOC_PART_NUMBER_MIMXRT1172DVMAA
	default "MIMXRT1171AVM8A" if SOC_PART_NUMBER_MIMXRT1171AVM8A
	default "MIMXRT1171CVM8A" if SOC_PART_NUMBER_MIMXRT1171CVM8A
	default "MIMXRT1171DVMAA" if SOC_PART_NUMBER_MIMXRT1171DVMAA
	help
	  This string holds the full part number of the SoC. It is a hidden option
	  that you should not set directly. The part number selection choice defines
	  the default value for this string.

config CM7_FREQ
	int "CM7 frequency (integer) in MHz"
	range 624 996
	default 996

config UPDATE_CM7_CLOCK
	bool "Configure CM7 clock"

config UPDATE_CM4_CLOCK
	bool "Configure CM4 clock"

config INIT_ENET_PLL
	bool "Initialize ENET PLL"

config ADJUST_DCDC
	bool "Adjust internal DCDC output"

config ENABLE_FBB
	bool "Enable FBB for high performance"

config BYPASS_LDO_LPSR
	bool "Bypass LDO lpsr"

config ADJUST_LDO
	bool "Adjust LDO setting"

endif # SOC_SERIES_IMX_RT10XX

menuconfig NXP_IMX_RT_BOOT_HEADER
	bool "Enable the boot header"
	help
	  Enable data structures required by the boot ROM to boot the
	  application from an external flash device.

if NXP_IMX_RT_BOOT_HEADER

choice BOOT_DEVICE
	prompt "Boot device selection"
	default BOOT_FLEXSPI_NOR

config BOOT_FLEXSPI_NOR
	bool "FlexSPI serial NOR"

config BOOT_FLEXSPI_NAND
	bool "FlexSPI serial NAND"

config BOOT_SEMC_NOR
	bool "SEMC parallel NOR"

config BOOT_SEMC_NAND
	bool "SEMC parallel NAND"

endchoice

config FLEXSPI_CONFIG_BLOCK_OFFSET
	hex "FlexSPI config block offset"
	default 0x0 if BOOT_FLEXSPI_NOR
	help
	  FlexSPI configuration block consists of parameters regarding specific
	  flash devices including read command sequence, quad mode enablement
	  sequence (optional), etc. The boot ROM expectes FlexSPI configuration
	  parameter to be presented in serail nor flash.

config IMAGE_VECTOR_TABLE_OFFSET
	hex "Image vector table offset"
	default 0x1000 if BOOT_FLEXSPI_NOR || BOOT_SEMC_NOR
	default 0x400 if BOOT_FLEXSPI_NAND || BOOT_SEMC_NAND
	help
	  The Image Vector Table (IVT) provides the boot ROM with pointers to
	  the application entry point and device configuration data. The boot
	  ROM requires a fixed IVT offset for each type of boot device.

config DEVICE_CONFIGURATION_DATA
	bool "Enable device configuration data"
	default y if HAS_MCUX_SEMC
	help
	  Device configuration data (DCD) provides a sequence of commands to
	  the boot ROM to initialize components such as an SDRAM.

endif # NXP_IMX_RT_BOOT_HEADER

choice CODE_LOCATION
	prompt "Code location selection"
	default CODE_FLEXSPI

config CODE_SEMC
	bool "Link code into external SEMC-controlled memory"

if SOC_MIMXRT1176_CM7
config CODE_ITCM
	bool "Link code into internal instruction tightly coupled memory (ITCM)"
endif # SOC_MIMXRT1176_CM7

if SOC_MIMXRT1176_CM4
config CODE_SRAM0
	bool "Link code into RAM_L memory (RAM_L)"
endif # SOC_MIMXRT1176_CM4

config CODE_FLEXSPI
	bool "Link code into external FlexSPI-controlled memory"
	select NXP_IMX_RT_BOOT_HEADER

endchoice
```

## soc/riscv/riscv-ite/it8xxx2/Kconfig.series
```kconfig
# Copyright (c) 2020 ITE Corporation. All Rights Reserved.
# SPDX-License-Identifier: Apache-2.0

config SOC_SERIES_RISCV32_IT8XXX2
	bool "ITE IT8XXX2 implementation"
	#depends on RISCV
	select COMPRESSED_ISA
	# TODO:
	# Error of can't link soft-float modules with single-float modules.
	# No library built with -mabi=ilp32f -march=rv32iafc?
	select CPU_HAS_FPU if RISCV_MUL_ISA
	select RISCV_ATOMICS_ISA
	select SOC_FAMILY_RISCV_ITE
	help
	    Enable support for ITE IT8XXX2
```

## tests/subsys/emul/testcase.yaml
```yaml
tests:
  subsys.emul:
    tags: devicetree
    # We only need this to run on one platform so use native_posix as it
    # will mostly likely be the fastest.
    platform_allow: native_posix
```
